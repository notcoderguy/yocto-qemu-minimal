## meta-minimal-can/conf/layer.conf
```bitbake
# We need to declare this directory as a valid Yocto layer
BBPATH .= ":${LAYERDIR}"
BBFILES += "${LAYERDIR}/recipes-*/*/*.bb \
            ${LAYERDIR}/recipes-*/*/*.bbappend"

BBFILE_COLLECTIONS += "minimal-can"
BBFILE_PATTERN_minimal-can = "^${LAYERDIR}/"
BBFILE_PRIORITY_minimal-can = "6"
LAYERSERIES_COMPAT_minimal-can = "scarthgap"
```
